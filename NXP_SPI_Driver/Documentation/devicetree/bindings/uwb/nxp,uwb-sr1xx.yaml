## NXP_SPI_Driver/Documentation/devicetree/bindings/uwb/nxp,uwb-sr1xx.yaml
```yaml
# SPDX-License-Identifier: (GPL-2.0 OR BSD-3-Clause)
# Copyright 2018-2022, 2024 NXP


%YAML 1.2
---
$id: http://devicetree.org/schemas/uwb/nxp,uwb-sr1xx.yaml#
$schema: http://devicetree.org/meta-schemas/core.yaml#

title: Ultra Wide Band(UWB)driver support for NXP SR1XX SOCs family

description: The nxp-sr1xx driver works for the NXP SR1XX series of Ultra Wide
    Band devices namely, SR150 and SR100T devices, and uses UWB Controller Interface (UCI).
    The corresponding details are available in the FiRa Consortium Website.
    (https://www.firaconsortium.org/). More details on the SR1XX Family can be
    found at https://www.nxp.com/products/:UWB-TRIMENSION
maintainers:
  - Manjunatha Venkatesh <manjunatha.venkatesh@nxp.com>

properties:
  compatible:
    enum:
      - nxp,srxxx

  reg:
    maxItems: 1

  spi-max-frequency:
    maximum: 45000000

required:
  - compatible
  - reg
  - spi-max-frequency

additionalProperties: false

examples:
  - |
    /* for Raspberry Pi with pin control stuff for GPIO irq */
    #include <dt-bindings/interrupt-controller/irq.h>
    #include <dt-bindings/gpio/gpio.h>

    fragment@1 {
        target = <&spi0>;
        __overlay__ {
            /* needed to avoid dtc warning */
            #address-cells = <1>;
            #size-cells = <0>;
            status = "disabled";

            srxxx: srxx@0 {
                compatible = "nxp,srxxx";
                reg = <0>;    /* CE0 */
                /* GPIO_24 (PIN 18) Host Irq*/
                nxp,sr1xx-irq-gpio = <&gpio 24 0>;
                /* GPIO_18(PIN 12) Chip Enable*/
                nxp,sr1xx-ce-gpio = <&gpio 18 0>;
                /* GPIO_23(PIN 16) Read Indication from Host to SR1xx*/
                nxp,sr1xx-ri-gpio = <&gpio 23 0>;
                /*max supported frequency */
                spi-max-frequency = <20000000>;
            };
        };
    };
```

## NXP_SPI_Driver/drivers/nxp/uwb/srxxx/Kconfig
```kconfig
#
# Uwb driver configuration
#

config NXP_UWB_SRXXX
	tristate "Nxp SR100 UCI protocol driver (SPI) devices"
```
